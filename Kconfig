## ports/renesas-ra/Kconfig
```kconfig
menu "Renesas RA Port Options"
    depends on PORT_RENESAS_RA

    comment "Renesas RA Specific Settings"

    # Note: Many hardware features (Clock settings, Peripheral enables like USB,
    #       Ethernet PHY, specific timer/serial instances) are configured via C defines
    #       in mpconfigboard.h or potentially via the Renesas FSP Configuration tool,
    #       not directly via Kconfig options here currently.

    # Add potential future Renesas RA-specific Kconfig options here.
    # Examples:
    # config MICROPY_HW_ETHERNET_ENABLED
    #    bool "Enable Ethernet MAC/PHY"
    #    default n

    comment "Common Option Defaults for Renesas RA"
    # Note: Defaults for common options are generally handled in py/ or extmod/ Kconfig.
    # Check common Kconfig files for specific default logic based on PORT_RENESAS_RA.
    # Key defaults include:
    # - MICROPY_ALLOC_PATH_MAX: 128
    # - MICROPY_USE_INTERNAL_ERRNO: y
    # - MICROPY_SCHEDULER_STATIC_NODES: y
    # - MICROPY_SCHEDULER_DEPTH: 8
    # - MICROPY_PY_SYS_PLATFORM: "renesas-ra"
    # - MICROPY_PY_OS_DUPTERM: 3
    # - MICROPY_PY_OS_DUPTERM_BUILTIN_STREAM: y
    # - MICROPY_PY_TIME_GMTIME_LOCALTIME_MKTIME: y
    # - MICROPY_PY_TIME_TIME_TIME_NS: y
    # - MICROPY_PY_USSL: y (via mpconfigport.mk default? Needs check)
    # - MICROPY_PY_UWEBSOCKET: y (via mpconfigport.mk default? Needs check)
    # - MICROPY_PY_WEBREPL: y (via mpconfigport.mk default? Needs check)

endmenu # Renesas RA Port Options
```

## ports/rp2/Kconfig
```kconfig
menu "RP2 Port Options"
    depends on PORT_RP2

    comment "RP2 Specific Features"

    config MICROPY_HW_ENABLE_DOUBLE_TAP
        bool "Enable double-tap reset to enter BOOTSEL"
        default y
        help
          Enable the feature where rapidly double-tapping the reset button
          (or RUN pin) causes the RP2040 to enter the USB Mass Storage
          bootloader mode (BOOTSEL).

    config MICROPY_C_HEAP_SIZE
        hex "C Heap Size (bytes) (0=disable)"
        default 0
        help
          Size of a dedicated C heap in bytes, allocated separately from the
          MicroPython GC heap. If enabled (non-zero), this heap is used by
          certain libraries or components that require standard `malloc`.
          If set to 0, the GC heap is used for C allocations if needed,
          or C allocations might fail if not supported by the GC allocator.
          Note: The RP2 port often does not require a separate C heap.

    # Add other RP2 specific options here, e.g.:
    # config MICROPY_HW_RP2_PIO_NUM_STATE_MACHINES
    #    int "Number of PIO State Machines to reserve"
    #    range 0 8
    #    default 4
    #    help
    #      Specify how many PIO state machines are reserved for use by the
    #      `rp2` module. The rest remain available for other uses.

    comment "Common Option Defaults for RP2"
    # Note: Defaults for common options are generally handled in py/ or extmod/ Kconfig.
    # RP2 port typically enables a rich set of features.
    # Check common Kconfig files for specific default logic.

endmenu # RP2 Port Options
```

## ports/samd/Kconfig
```kconfig
menu "SAMD Port Options"
    depends on PORT_SAMD

    comment "SAMD Specific Settings"

    config MICROPY_HW_CODESIZE
        string "Available Code Size (e.g., 184K, 368K)"
        default "184K" if SOC_SERIES_SAMD21 # Default for SAMD21
        default "368K" if SOC_SERIES_SAMD51 # Default for SAMD51
        help
          Specifies the approximate available code size on the target MCU.
          This influences which features (like frozen modules) are included
          by default based on the MCU series.
          (This is usually set automatically by the build system based on the selected MCU).

    config MICROPY_HW_MCUFLASH
        bool "Use internal MCU flash for primary filesystem"
        depends on MICROPY_VFS
        default y if !(MICROPY_HW_QSPIFLASH || MICROPY_HW_SPIFLASH)
        help
            Use a portion of the internal flash memory of the SAMD MCU for
            the primary filesystem (usually mounted at "/").
            This is the default filesystem location if no external QSPI or SPI
            flash is configured for the board.

    # Placeholders for board-specific QSPI/SPI flash config
    # These would typically be selected/enabled by the board's Kconfig fragment
    # or mpconfigboard.h/mk based on hardware presence.
    config MICROPY_HW_QSPIFLASH
        bool "QSPI Flash Chip Present"
        default n
        help
          Indicates that an external QSPI flash chip is present and configured
          on the board, potentially for use as a filesystem or for other storage.

    config MICROPY_HW_SPIFLASH
        bool "SPI Flash Chip Present"
        default n
        help
          Indicates that an external SPI flash chip is present and configured
          on the board, potentially for use as a filesystem or for other storage.

    # Add other SAMD specific options here, e.g.
    # config MICROPY_HW_ENABLE_SERCOM_ANALOG_INPUT
    #    bool "Enable Analog Input on SERCOM pads"
    #    default n

    comment "Common Option Defaults for SAMD"
    # Note: Defaults for common options are generally handled in py/ or extmod/ Kconfig.
    # Check common Kconfig files for specific default logic based on PORT_SAMD.
    # Key defaults include:
    # - MICROPY_PY_BUILTINS_COMPLEX: n
    # - MICROPY_ERROR_REPORTING: TERSE
    # - MICROPY_PY_OS_DUPTERM: 3
    # - MICROPY_PY_TIME_GMTIME_LOCALTIME_MKTIME: y
    # - MICROPY_PY_TIME_TIME_TIME_NS: y

endmenu # SAMD Port Options

# Define SoC series symbols for conditional logic (set by build system/board config)
config SOC_SERIES_SAMD21
    bool
config SOC_SERIES_SAMD51
    bool
```

## ports/stm32/Kconfig
```kconfig
menu "STM32 Port Options"
    depends on PORT_STM32

# Common options below are defined in py/ or extmod/ Kconfig files.
# Default values for STM32 are set there using 'if PORT_STM32'.
# Relevant common options and their STM32 defaults:
# - MICROPY_FLOAT_IMPL: float (can be board overridden)
# - MICROPY_PY_THREAD: n
# - MICROPY_PY_NETWORK: y
# - MICROPY_PY_NETWORK_PPP_LWIP: n
# - MICROPY_PY_SOCKET: y (if MICROPY_PY_NETWORK)
# - MICROPY_VFS_FAT: y
# - MICROPY_VFS_ROM: y (if HW ROMFS enabled)
# - MICROPY_HW_ENABLE_RNG: y (used by uos.urandom default)
# - MICROPY_PY_LWIP_SOCK_RAW: y
# - MICROPY_PY_WEBSOCKET: y (if lwIP)
# - MICROPY_PY_WEBREPL: y (if lwIP)
# - MICROPY_PY_OS_DUPTERM: 3
# - MICROPY_PY_OS_DUPTERM_BUILTIN_STREAM: y
# - MICROPY_PY_OS_DUPTERM_STREAM_DETACHED_ATTACHED: y
# - MICROPY_FATFS_ENABLE_LFN: n

# Port-specific options:
config MBOOT_ENABLE_PACKING
    bool "Enable Mboot firmware packing (encryption/signing)"
    default n
    help
      Enable support for encrypted and/or signed firmware updates using Mboot.
      Requires MBOOT_PACK_KEYS_FILE to be defined, usually in the board config.

config MBOOT_PACK_CHUNKSIZE
    int "Mboot packing chunk size"
    depends on MBOOT_ENABLE_PACKING
    default 16384
    help
      Chunk size used for encrypting/signing firmware for Mboot.
      Must match the Mboot configuration.

config MBOOT_PACK_KEYS_FILE
    string "Mboot packing keys file"
    depends on MBOOT_ENABLE_PACKING
    default "$(BOARD_DIR)/mboot_keys.h"  # This won't work directly, needs translation in Makefile
    help
      Path to the header file containing keys for Mboot firmware packing.
      The Makefile needs to translate this Kconfig string path into a usable Make variable.

    config MICROPY_HW_ENABLE_ISR_UART_FLASH_FUNCS_IN_RAM
        bool "Place ISR/UART/Flash functions in RAM"
        default n
        help
            Place critical interrupt handlers, UART drivers, and flash programming
            functions into RAM. This is sometimes necessary if these functions
            need to run while the flash is being modified or cannot be accessed,
            or for performance reasons. Increases RAM usage.

    # Add other truly STM32-specific Kconfig options here.

endmenu # STM32 Port Options
```

## ports/unix/Kconfig
```kconfig
menu "Unix Port Options"
    depends on PORT_UNIX

    comment "Build Options"

    config MICROPY_FORCE_32BIT
        bool "Force 32-bit build on 64-bit host"
        default n
        help
          Compile the Unix port as a 32-bit binary even when the host
          system is 64-bit. Requires appropriate compiler support (e.g., -m32 flag).

    config MICROPY_STANDALONE
        bool "Build standalone (use bundled libraries)"
        default n
        help
          Avoid using system-installed libraries like libffi, use the versions
          bundled as submodules within the MicroPython source tree instead.
          Useful for creating more self-contained binaries or when system libraries
          are unavailable or incompatible.

    config MICROPY_UNIX_COVERAGE
        bool "Enable code coverage build (for development)"
        default n
        help
          Build the unix port with gcov instrumentation (`-fprofile-arcs -ftest-coverage`)
          for code coverage analysis. This is intended for development and testing.

    comment "REPL Configuration"

    choice
        prompt "Readline Implementation"
        default MICROPY_USE_READLINE_MPY
        help
          Select the readline implementation for the interactive REPL, providing
          features like history and line editing.

    config MICROPY_USE_READLINE_NONE
        bool "None (simple input)"
        help
          Disable readline features entirely. Use basic standard input with no
          history or advanced editing capabilities.

    config MICROPY_USE_READLINE_MPY
        bool "MicroPython readline"
        help
          Use the built-in MicroPython readline implementation, providing basic
          history and emacs-style line editing (if enabled).

    # Option for system readline could be added here if needed
    # config MICROPY_USE_READLINE_SYSTEM
    #     bool "System readline"
    #     help
    #       Use the system's readline library (e.g., GNU Readline). Requires
    #       the corresponding development library (e.g., libreadline-dev) installed.
    #       May offer more advanced features but adds an external dependency.

    endchoice

    comment "Optional Modules"

    config MICROPY_PY_FFI
        bool "Enable ffi module (Foreign Function Interface)"
        default y
        select MICROPY_LIB_LIBFFI if !MICROPY_STANDALONE
        help
          Enable the 'ffi' module to load shared libraries and call C functions
          directly from Python code. If MICROPY_STANDALONE is not set,
          requires the libffi development library installed on the host system.

    config MICROPY_PY_JNI
        bool "Enable jni module (Java Native Interface - Experimental)"
        default n
        help
          Enable the experimental 'jni' module for basic interaction with a
          Java Virtual Machine (JVM) using the Java Native Interface (JNI).
          Requires a JDK installed and configured.

    config MICROPY_PY_TERMIOS
        bool "Enable termios module (POSIX terminal control)"
        default y
        help
          Enable the 'termios' module, providing an interface to the POSIX
          terminal control API for manipulating TTY settings.

    config MICROPY_PY_SOCKET
        bool "Enable socket module (standard networking)"
        depends on MICROPY_PY_NETWORK # Depends on network stack
        default y
        help
          Enable the standard 'socket' module for network programming.
          On the Unix port, this uses the standard POSIX socket API.

    comment "Port-specific Behaviour"

    config MICROPY_EPOCH_IS_1970
        bool "VFS stat functions use 1970 epoch"
        default y
        help
          Configure VFS stat functions (like the time fields in `uos.stat()`)
          to return time values based on the standard Unix epoch (seconds since 1970-01-01).
          If disabled, the epoch defaults to 2000-01-01.

    config MICROPY_SELECT_REMAINING_TIME
        bool "Assume select() updates timeout on EINTR"
        default y
        help
          Assume that the `select()` system call, when interrupted by a signal
          (returning EINTR), correctly updates the timeout argument to reflect
          the remaining time. This is POSIX standard behavior, but disabling
          might be necessary for compatibility with very old or non-compliant systems.

    config MICROPY_MODULE_OVERRIDE_MAIN_IMPORT
        bool "Allow importing file with __name__ == '__main__'"
        default y
        help
          Enable the behavior where importing a `.py` file directly (e.g., using
          the `-m` command-line flag) sets its `__name__` attribute to `'__main__'`
          instead of the module's filename.

    config MICROPY_PY_SYS_EXECUTABLE
        bool "Provide sys.executable path"
        default y
        help
          Enable the `sys.executable` variable, which contains the absolute path
          to the running MicroPython executable.

    # Placeholder for library selection
    config MICROPY_LIB_LIBFFI
        bool

endmenu # Unix Port Options
```

## ports/webassembly/Kconfig
```kconfig
menu "WebAssembly Port Options"
    depends on PORT_WEBASSEMBLY

    comment "WebAssembly Specific Settings"

    # This port runs in a web browser or Node.js environment using Emscripten.
    # Configuration is primarily via mpconfigport.h and Emscripten build flags.

    # Add potential future WebAssembly-specific Kconfig options here.
    # Examples might include:
    # config MICROPY_WASM_NODEJS
    #    bool "Target Node.js environment"
    #    default n
    # config MICROPY_WASM_FETCH_ENABLED
    #    bool "Enable Fetch API support"
    #    default y

    comment "Common Option Defaults for WebAssembly"
    # Note: Defaults for common options are generally handled in py/ or extmod/ Kconfig.
    # WebAssembly likely enables a rich feature set similar to Unix.
    # Check common Kconfig files for specific default logic based on PORT_WEBASSEMBLY.

endmenu # WebAssembly Port Options
```

## ports/windows/Kconfig
```kconfig
menu "Windows Port Options"
    depends on PORT_WINDOWS # Assuming PORT_WINDOWS will be the symbol for this port

    # --- Windows Specific Features --- #
    comment "Windows Port Features"

    config MICROPY_FORCE_32BIT
        bool "Force 32-bit build on 64-bit host"
        default n
        help
          Compile the Windows port as a 32-bit binary even when the host
          system is 64-bit. Requires appropriate compiler support (e.g., /MACHINE:X86 for MSVC).

    choice
        prompt "Readline Implementation"
        default MICROPY_USE_READLINE_MPY
        help
          Select the readline implementation for the REPL.

    config MICROPY_USE_READLINE_NONE
        bool "None (simple input)"
        help
          Disable readline features, use basic standard input.

    config MICROPY_USE_READLINE_MPY
        bool "MicroPython readline"
        help
          Use the built-in MicroPython readline implementation.

    endchoice

    # --- Common Option Notes --- #
    comment "Common Option Defaults for Windows"
    # Note: Defaults for common options are generally handled in py/ or extmod/ Kconfig.
    # Windows port typically aligns closely with full features.

endmenu # Windows Port Options
```
